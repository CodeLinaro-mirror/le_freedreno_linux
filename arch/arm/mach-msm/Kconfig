## arch/arm/mach-msm/Kconfig
```kconfig
if ARCH_MSM

comment "Qualcomm MSM SoC Type"
	depends on ARCH_MSM_DT

choice
	prompt "Qualcomm MSM SoC Type"
	default ARCH_MSM7X00A
	depends on !ARCH_MSM_DT

config ARCH_MSM7X00A
	bool "MSM7x00A / MSM7x01A"
	select ARCH_MSM_ARM11
	select CPU_V6
	select GPIO_MSM_V1
	select MACH_TROUT if !MACH_HALIBUT
	select MSM_PROC_COMM
	select MSM_SMD
	select MSM_REMOTE_SPINLOCK_SWP

config ARCH_MSM7X30
	bool "MSM7x30"
	select ARCH_MSM_SCORPION
	select CPU_V7
	select GPIO_MSM_V1
	select MACH_MSM7X30_SURF # if !
	select MSM_GPIOMUX
	select MSM_PROC_COMM
	select MSM_SMD
	select MSM_VIC
	select MSM_REMOTE_SPINLOCK_DEKKERS

config ARCH_QSD8X50
	bool "QSD8X50"
	select ARCH_MSM_SCORPION
	select CPU_V7
	select GPIO_MSM_V1
	select MACH_QSD8X50_SURF if !MACH_QSD8X50A_ST1_5
	select MSM_GPIOMUX
	select MSM_PROC_COMM
	select MSM_SMD
	select MSM_VIC
	select MSM_REMOTE_SPINLOCK_LDREX

endchoice

config ARCH_MSM8X60
	bool "MSM8X60"
	select ARCH_MSM_DT
	select ARM_GIC
	select CPU_V7
	select GPIO_MSM_V2
	select HAVE_SMP
	select MSM_SCM if SMP

config ARCH_MSM8960
	bool "MSM8960"
	select ARCH_MSM_DT
	select ARM_GIC
	select CPU_V7
	select HAVE_SMP
	select GPIO_MSM_V2
	select MSM_SCM if SMP

config ARCH_MSM8974
	bool "MSM8974"
	select ARCH_MSM_DT
	select ARM_GIC
	select CPU_V7
	select HAVE_ARM_ARCH_TIMER
	select HAVE_SMP
	select MSM_SCM if SMP
	select USE_OF

config ARCH_MSM_DT
	bool
	select SPARSE_IRQ
	select USE_OF
	select MSM_REMOTE_SPINLOCK_AUTO
	select MSM_SMD

config MSM_HAS_DEBUG_UART_HS
	bool

config MSM_SOC_REV_A
	bool

config  ARCH_MSM_ARM11
	bool

config  ARCH_MSM_SCORPION
	bool

config  MSM_VIC
	bool

menu "Qualcomm MSM Board Type"
	depends on !ARCH_MSM_DT

config MACH_HALIBUT
	depends on ARCH_MSM
	depends on ARCH_MSM7X00A
	bool "Halibut Board (QCT SURF7201A)"
	help
	  Support for the Qualcomm SURF7201A eval board.

config MACH_TROUT
	depends on ARCH_MSM
	depends on ARCH_MSM7X00A
	bool "HTC Dream (aka trout)"
	help
	  Support for the HTC Dream, T-Mobile G1, Android ADP1 devices.

config MACH_MSM7X30_SURF
	depends on ARCH_MSM7X30
	bool "MSM7x30 SURF"
	help
	  Support for the Qualcomm MSM7x30 SURF eval board.

config MACH_QSD8X50_SURF
	depends on ARCH_QSD8X50
	bool "QSD8x50 SURF"
	help
	  Support for the Qualcomm QSD8x50 SURF eval board.

config MACH_QSD8X50A_ST1_5
	depends on ARCH_QSD8X50
	bool "QSD8x50A ST1.5"
	select MSM_SOC_REV_A
	help
	  Support for the Qualcomm ST1.5.

endmenu

config MSM_PROC_COMM
	bool

choice
	prompt "Remote Spinlock Implementation"
	default MSM_REMOTE_SPINLOCK_AUTO

config MSM_REMOTE_SPINLOCK_DEKKERS
	prompt "Dekker's algorithm"
	bool
config MSM_REMOTE_SPINLOCK_SWP
	prompt "SWP-based locks"
	depends on !THUMB2_KERNEL
	bool
config MSM_REMOTE_SPINLOCK_LDREX
	prompt "LDREX/STREX"
	bool
config MSM_REMOTE_SPINLOCK_SFPB
	prompt "SFPB Hardware Mutex Registers"
	bool
config MSM_REMOTE_SPINLOCK_AUTO
	prompt "Use DT info to configure; fallback to LDREX"
	bool

endchoice

config MSM_SMEM
	bool

config MSM_SMD
	bool "MSM Shared Memory Driver (SMD)"
	select MSM_SMEM
	help
	  Support for the shared memory interface between the apps
	  processor and the baseband processor.  Provides access to
	  the "shared heap", as well as virtual serial channels
	  used to communicate with various services on the baseband
	  processor.

choice
	prompt "MSM Shared memory interface version"
	depends on MSM_SMD
	default MSM_SMD_PKG3 if ARCH_MSM_ARM11
	default MSM_SMD_PKG4 if (ARCH_MSM_SCORPION || ARCH_MSM_DT)

	config MSM_SMD_PKG3
	  bool
	    prompt "Package 3"

	config MSM_SMD_PKG4
	  bool
	    prompt "Package 4"
endchoice

config MSM_N_WAY_SMD
	depends on (MSM_SMD && !(ARCH_MSM7X01A))
	default y
	bool "MSM N-WAY SMD support"
	help
	  Supports APPS-QDSP SMD communication along with
	  normal APPS-MODEM SMD communication.

config MSM_N_WAY_SMSM
	depends on (MSM_SMD && !(ARCH_MSM7X01A))
	default y
	bool "MSM N-WAY SMSM support"
	help
	  Supports APPS-QDSP SMSM communication along with
	  normal APPS-MODEM SMSM communication.

config MSM_GPIOMUX
	bool
	depends on !ARCH_MSM_DT
	help
	  Support for MSM V1 TLMM GPIOMUX architecture.

config MSM_SCM
	bool
endif
```
